## config/west.yml
```yaml
manifest:
  remotes:
    - name: zmk
      url-base: https://github.com/bullwinkle3000
  projects:
    - name: zmk
      remote: zmk
      revision: pmw3610-aml
      import: app/west.yml
  self:
    path: config
```
